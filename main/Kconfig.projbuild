## main/Kconfig.projbuild
```kconfig
menu "Example Configuration"

    # visible if CUSTOM_COMMISSIONABLE_DATA_PROVIDER

    config DYNAMIC_PASSCODE_COMMISSIONABLE_DATA_PROVIDER
        bool "Enable Dynamic Passcode Commissionable Data Provider"
        depends on CUSTOM_COMMISSIONABLE_DATA_PROVIDER
        default y

    config DYNAMIC_PASSCODE_PROVIDER_DISCRIMINATOR
        int "Discriminator in Dynamic Passcode Commissionable Data Provider"
        depends on DYNAMIC_PASSCODE_COMMISSIONABLE_DATA_PROVIDER
        default 3840
        range 0 4095
        help
            Fixed discriminator in custom dynamic passcode commissionable data provider

    config DYNAMIC_PASSCODE_PROVIDER_ITERATIONS
        int "Iterations in Dynamic Passcode Commissionable Data Provider"
        depends on DYNAMIC_PASSCODE_COMMISSIONABLE_DATA_PROVIDER
        default 10000
        range 1000 100000
        help
            Fixed iterations in custom dynamic passcode commissionable data provider

    config DYNAMIC_PASSCODE_PROVIDER_SALT_BASE64
        string "Base64-Encoded Salt in Dynamic Passcode Commissionable Data Provider"
        depends on DYNAMIC_PASSCODE_COMMISSIONABLE_DATA_PROVIDER
        default "0NHS09TV1tfY2drb3N3e36ChoqOkpaanqKmqq6ytrq8="
        help
            Fixed salt in custom dynamic passcode commissionable data provider. It should be a Base64-Encoded string.

    config SUBSCRIBE_AFTER_BINDING
        bool "Enable subscribe to server after binding"
        default y
        help
            "When enabled the firmware will automatically create a Matter subscription after a binding entry is added. This option pulls in the extra client‑side code needed to receive attribute reports from a BooleanState (contact‑sensor) cluster."

	choice
        prompt "Device Primary Mode"
        default MODE_PRIMARY_CLOSURE
        help
          Select which primary functionality the device will expose.
          Only ONE of the three options can be enabled at a time.
          The selected mode can be used with “depends on MODE_PRIMARY_…”
          in other Kconfig symbols or source files.

        config MODE_PRIMARY_CLOSURE
            bool "Closure mode"
            help
              Build the firmware for the *closure* use‑case.  This enables the
              WindowCovering server cluster and disables the chime/cover specific
              code paths.

        config MODE_PRIMARY_CHIME
            bool "Chime mode"
            help
              Build the firmware for the *chime* use‑case.  This enables the
              Identify/OnOff clusters needed for a door‑bell style device.
			
        config MODE_WINDOW_COVERING_LEGACY
            bool "Window Covering Legacy mode"
            help
              Build the firmware for the *window covering legacy* use‑case. This enables the WindowCovering server cluster without the closure control cluster, and disables the chime/closure specific code paths.
		
		config MODE_CONTACT_SENSOR
			bool "Contact Sensor mode"
			help
			  Build the firmware for the *contact sensor* use‑case.
	endchoice
endmenu
```

## sdkconfig.defaults
```kconfig
CONFIG_ESPTOOLPY_FLASHSIZE_4MB=y

#enable BT
CONFIG_BT_ENABLED=y
CONFIG_BT_NIMBLE_ENABLED=y

#disable BT connection reattempt
CONFIG_BT_NIMBLE_ENABLE_CONN_REATTEMPT=n

#enable lwip ipv6 autoconfig
CONFIG_LWIP_IPV6_AUTOCONFIG=y

# Use a custom partition table
CONFIG_PARTITION_TABLE_CUSTOM=y
CONFIG_PARTITION_TABLE_FILENAME="partitions.csv"
CONFIG_PARTITION_TABLE_OFFSET=0xC000

# This example only use 2 dynamic endpoints
CONFIG_ESP_MATTER_MAX_DYNAMIC_ENDPOINT_COUNT=2

# Enable OpenThread
CONFIG_OPENTHREAD_ENABLED=y
CONFIG_OPENTHREAD_SRP_CLIENT=y
CONFIG_OPENTHREAD_DNS_CLIENT=y
CONFIG_OPENTHREAD_LOG_LEVEL_DYNAMIC=n
CONFIG_OPENTHREAD_LOG_LEVEL_NOTE=y
CONFIG_OPENTHREAD_CLI=n

# Disable lwip ipv6 autoconfig
CONFIG_LWIP_IPV6_AUTOCONFIG=n

# LwIP config for OpenThread
CONFIG_LWIP_IPV6_NUM_ADDRESSES=8
CONFIG_LWIP_MULTICAST_PING=y

# MDNS platform
CONFIG_USE_MINIMAL_MDNS=n
CONFIG_ENABLE_EXTENDED_DISCOVERY=y

# Disable WiFi on esp32c6
CONFIG_ESP_WIFI_ENABLED=n
CONFIG_ENABLE_WIFI_STATION=n
CONFIG_ENABLE_WIFI_AP=n

#enable lwIP route hooks
CONFIG_LWIP_HOOK_IP6_ROUTE_DEFAULT=y
CONFIG_LWIP_HOOK_ND6_GET_GW_DEFAULT=y

# Button
CONFIG_BUTTON_PERIOD_TIME_MS=20
CONFIG_BUTTON_LONG_PRESS_TIME_MS=5000

# disable softap by default
CONFIG_ESP_WIFI_SOFTAP_SUPPORT=n

# Enable OTA Requestor
CONFIG_ENABLE_OTA_REQUESTOR=n

# Enable HKDF in mbedtls
CONFIG_MBEDTLS_HKDF_C=y

# Buttons
CONFIG_BSP_BUTTONS_NUM=1
```
